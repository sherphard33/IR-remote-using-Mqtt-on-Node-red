//Phoenixaiden MagicianGirl33 28/03/2019
#include <ESP8266WiFi.h>
#include <PubSubClient.h>
#ifndef UNIT_TEST
#include <Arduino.h>
#endif
#include <IRremoteESP8266.h>
#include <IRsend.h>   
#define LED_PIN 2
int t = 5;
int t1 = 4;
int swingSp = 0;

// network credentials
const char* ssid = "WIFI"; //Your WI-FI SSID
const char* password = "password";//Your Wi-Fi password

//MQTT server IP address
const char* mqtt_server = "192.168.1.134";

WiFiClient irClient;
PubSubClient client(irClient);

const uint16_t kIrLed = 4;
IRsend irsend(kIrLed);
uint16_t temp16[205] = {152, 6674,  124, 19476,  126, 24706,  6100, 7430,  498, 1672,  528, 1674,  518,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 7412,  542};  // UNKNOWN 44AEA51D
uint16_t temp18[199] = {124, 47618,  6054, 7402,  526, 1634,  564, 1632,  566, 1630,  564, 1630,  568,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 7406,  552};  // UNKNOWN FF55EEBB
uint16_t temp20[197] = {6000, 7406,  526, 1672,  494, 1662,  562, 1634,  562, 1636,  514, 1684,  514,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 7364,  512};  // UNKNOWN E1A8B66F
uint16_t temp22[199] = {6036, 7430,  506, 1766,  432, 1700,  494, 1700,  498, 1704,  494, 1634,  568,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 7890,  128};  // UNKNOWN A685D8E1
uint16_t temp23[197] = {6142, 7392,  544, 1662,  512, 1778,  394, 1702,  540, 1662,  514, 1736,  464,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 7432,  496};  // UNKNOWN 7F5988EF
uint16_t temp24[207] = {126, 2436,  62, 7048,  6130, 7368,  568, 1672,  528, 1630,  540, 1702,  498,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 8980,  58};  // UNKNOWN 3AC6C93
uint16_t temp25[197] = {6032, 7420,  486, 1720,  456, 1722,  514, 1688,  512, 1692,  458, 1746,  484,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 7404,  556};  // UNKNOWN DD10F2D
uint16_t temp26[199] = {126, 12936,  6110, 7368,  570, 1632,  560, 1636,  540, 1702,  496, 1692,  508,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 7466,  500};  // UNKNOWN 2D8C10FF
uint16_t temp28[197] = {6040, 7390,  544, 1704,  492, 1708,  488, 1698,  502, 1670,  528, 1632,  564,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 7426,  536};  // UNKNOWN 7646450
uint16_t temp30[197] = {6084, 7392,  540, 1672,  526, 1676,  524, 1632,  536, 1662,  514, 1686,  570,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 7462,  494};  // UNKNOWN B5D57AA1
uint16_t temp32[197] = {6084, 7408,  528, 1674,  522, 1634,  538, 1662,  514, 1690,  560, 1676,  524,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 7420,  566};  // UNKNOWN 13B4E4DA

uint16_t mode_auto[213] = {126, 2792,  104, 6924,  104, 1008,  126, 2948,  126, 3292,  126, 1022,  128,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 7418,  512};  // UNKNOWN 6AA37DFA
uint16_t mode_cool[201] = {124, 2368,  6062, 7370,  562, 1638,  536, 1664,  534, 1704,  494, 1664,  532,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 17134,  126};  // UNKNOWN 87E91499
uint16_t mode_heat[209] = {128, 5856,  126, 8538,  56, 2280,  128, 1978,  128, 8954,  128, 20418,  5960,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 7460,  526};  // UNKNOWN EFCCB46D

uint16_t turbo[199] = {148, 35956,  6092, 7396,  536, 1676,  528, 1630,  564, 1634,  536, 1664,  514,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 7378,  536};  // UNKNOWN E779BA6E
uint16_t turbo_[201] = {154, 2060,  126, 20854,  6098, 7408,  526, 1634,  536, 1666,  512, 1690,  560,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 7370,  564};  // UNKNOWN AFDE7727

uint16_t swing1[203] = {126, 9582,  126, 4030,  126, 45382,  6064, 7434,  502, 1696,  502, 1700,  498,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 7400,  564};  // UNKNOWN 1396ABD5
uint16_t swing2[197] = {6086, 7412,  526, 1636,  514, 1686,  514, 1694,  564, 1668,  502, 1664,  538,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 7462,  506};  // UNKNOWN DB36A8A9
uint16_t swing3[197] = {6064, 7442,  474, 1726,  526, 1672,  502, 1698,  502, 1700,  500, 1676,  526,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 7492,  472};  // UNKNOWN 35DEB488

uint16_t tvPwr[73] = {4564, 4422,  594, 526,  594, 1644,  594, 1646,  594, 1646,  594, 528,  594,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 1644,  596};  // SAMSUNG 707030CF
uint16_t mute[73] = {4450, 4534,  616, 504,  618, 1622,  616, 1624,  616, 1624,  616, 506,  616,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 1624,  614};  // SAMSUNG 7070B04F
uint16_t vol_Up[67] = {4544, 4442,  600, 522,  600, 1640,  600, 1640,  600, 1640,  600, 520,  600,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 1642,  598};  // SAMSUNG 707028D7
uint16_t vol_Down[73] = {4524, 4464,  582, 538,  580, 1658,  580, 1660,  580, 1660,  580, 542,  578,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 1670,  568};  // SAMSUNG 7070A857
uint16_t menu[73] = {4582, 4404,  606, 516,  638, 1600,  640, 1600,  640, 1600,  640, 482,  640,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 1598,  640};  // SAMSUNG 70708877
uint16_t source[73] = {4450, 4530,  608, 510,  608, 1630,  608, 1630,  610, 1630,  608, 512,  608,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 1658,  582};  // SAMSUNG 7070F00F
uint16_t ok[73] = {4576, 4408,  596, 524,  596, 1644,  596, 1640,  598, 1644,  596, 526,  596,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 1608,  630};  // SAMSUNG 7070629D
uint16_t Exit[73] = {4584, 4396,  646, 476,  644, 1594,  646, 1594,  644, 1594,  644, 476,  644,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 1596,  638};  // SAMSUNG 7070AD52
uint16_t left[73] = {4430, 4554,  492, 628,  492, 1748,  492, 1746,  494, 1746,  492, 628,  492,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 1620,  586};  // SAMSUNG 707022DD
uint16_t right[73] = {4614, 4370,  672, 450,  670, 1568,  670, 1568,  672, 1568,  672, 450,  670,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 1568,  672};  // SAMSUNG 7070A25D
uint16_t up[73] = {4616, 4370,  614, 508,  612, 1626,  614, 1624,  614, 1628,  612, 510,  610,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 1590,  650};  // SAMSUNG 707042BD
uint16_t down[73] = {4432, 4550,  650, 470,  650, 1588,  650, 1590,  648, 1588,  650, 472,  650,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 1650,  588};  // SAMSUNG 7070C23D


void wifiConnect() {
  delay(10);
  // We start by connecting to a WiFi network
  Serial.println();
  Serial.print("Connecting to ");
  Serial.println(ssid);
  WiFi.begin(ssid, password);
  while (WiFi.status() != WL_CONNECTED) {
    delay(500);
    Serial.print(".");
  }
  Serial.println("");
  Serial.print("WiFi connected - ESP IP address: ");
  Serial.println(WiFi.localIP());
}

/////////////////////////////////////////////////////////RECONNECT
void reconnect() {
  // Loop until we're reconnected
  while (!client.connected()) {
    Serial.print("Attempting MQTT connection...");
    // Attempt to connect
    
    if (client.connect("ESP_IR")) {
      Serial.println("connected");  
      // Subscribe or resubscribe to a topic
      // You can subscribe to more topics (to control more LEDs in this example)
      client.subscribe("Room/AC");
      client.subscribe("Room/TV");
    } else {
      Serial.print("failed, rc=");
      Serial.print(client.state());
      Serial.println(" try again in 5 seconds");
      // Wait 5 seconds before retrying
      delay(5000);
    }
  }
}
////////////////////////////////////////////////////////////////////////////////////////////////////////////////////////////////

void callback(String topic, byte* message, unsigned int length) 
{
  Serial.print("Message arrived on topic: ");
  Serial.print(topic);
  Serial.print(". Message: ");
  String messageTemp;
  
  for (int i = 0; i < length; i++) {
    Serial.print((char)message[i]);
    messageTemp += (char)message[i];
  }
  Serial.println();
   
   ///CHANGING AC TEMPERATURES #SirAir---------------------------------------------------------------------------------------------------------
  if(topic=="Room/AC")
  {
      if(messageTemp == "16")
      { 
        Serial.println("temp 16");
        irsend.sendRaw(temp16, 205, 38);  // Send a raw data capture at 38kHz.
      }
      if(messageTemp == "18")
      { 
        Serial.println("temp 18");
        irsend.sendRaw(temp18, 199, 38);  // Send a raw data capture at 38kHz.
      }
      if(messageTemp == "20")
      { 
        Serial.println("temp 20");
        irsend.sendRaw(temp20, 197, 38);  // Send a raw data capture at 38kHz.
      }
      if(messageTemp == "22")
      { 
        Serial.println("temp 22");
        irsend.sendRaw(temp22, 199, 38);  // Send a raw data capture at 38kHz.
      }
      if(messageTemp == "23")
      { 
        Serial.println("temp 23");
        irsend.sendRaw(temp23, 197, 38);  // Send a raw data capture at 38kHz.
      }
      if(messageTemp == "24")
      { 
        Serial.println("temp 24");
        irsend.sendRaw(temp24, 207, 38);  // Send a raw data capture at 38kHz.
      }
      if(messageTemp == "25")
      { 
        Serial.println("temp 25");
        irsend.sendRaw(temp25, 197, 38);  // Send a raw data capture at 38kHz.
      }
      if(messageTemp == "26")
      { 
        Serial.println("temp 26");
        irsend.sendRaw(temp26, 199, 38);  // Send a raw data capture at 38kHz.
      }
      if(messageTemp == "28")
      { 
        Serial.println("temp 28");
        irsend.sendRaw(temp28, 197, 38);  // Send a raw data capture at 38kHz.
      }
      if(messageTemp == "30")
      { 
        Serial.println("temp 30");
        irsend.sendRaw(temp30, 197, 38);  // Send a raw data capture at 38kHz.
      }
      if(messageTemp == "32")
      { 
        Serial.println("temp 32");
        irsend.sendRaw(temp32, 197, 38);  // Send a raw data capture at 38kHz.
      }
      if(messageTemp == "test1") 
      {
        digitalWrite(LED_PIN, HIGH);
      }
      ////////////////////////////////////////////////////NEW MODE AUTO n COOL
      if(messageTemp == "mode_auto")
      {
        Serial.println("AUTO");
        irsend.sendRaw(mode_auto, 213, 38);
      }
      //mode_cool[201]
      if(messageTemp == "mode_cool")
      {
        Serial.println("COOL");
        irsend.sendRaw(mode_cool, 201, 38);
      }
      //swingSp,swing1[203]192////////////////////////////////////////////////////NEW SWING
      if(messageTemp == "swing")
      {
        if(swingSp == 0)
        {
           Serial.println("SWING1");
           irsend.sendRaw(swing1, 203, 38);
          }
        if(swingSp == 1)
        {
          Serial.println("SWING2");
          irsend.sendRaw(swing2, 197, 38);
        }
        if(swingSp == 2)
        {
          Serial.println("SWING3");
          irsend.sendRaw(swing3, 197, 38);
        }
        swingSp++;
        if(swingSp == 3)
        {
          swingSp = 0;
          }
      }
      if(messageTemp == "test0") 
      {
        digitalWrite(LED_PIN, LOW);
      }/////////////****?////////////*****/////////////****//////////////////////
      
            
  }
  //CONTROLS FOR THE TV #SAMSUNG
  if(topic=="Room/TV")
  {
    if(messageTemp == "vol_U")
      {
        //vol_Up
        Serial.println("Volume Up");
        irsend.sendRaw(vol_Up, 67, 38);  // Send a raw data capture at 38kHz.
      }
      //////////////////////////////////////////////////////NEW VOL DOWN
      if(messageTemp == "vol_D")
      {
        Serial.println("Volume Down");
        irsend.sendRaw(vol_Down, 73, 38);  // Send a raw data capture at 38kHz.
      }
      //source[815]////////////////////////////////////////////////////NEW SOURCE
      if(messageTemp == "source")
      {
        //vol_Up
        Serial.println("Source");
        irsend.sendRaw(source, 73, 38);  // Send a raw data capture at 38kHz.
      }
      if(messageTemp == "mute")
      {
        //mute
        Serial.println("mute TV");
        irsend.sendRaw(mute, 73, 38);  // Send a raw data capture at 38kHz.
      }
      if(messageTemp == "tv")
      {
        Serial.println("TV");
        irsend.sendRaw(tvPwr, 73, 38);  // Send a raw data capture at 38kHz.
      }
       //Menu
        if(messageTemp == "menu")
      {
        //vol_Up
        Serial.println("Menu");
        irsend.sendRaw(menu, 73, 38);  // Send a raw data capture at 38kHz.
      }
      //////////////////////////////////////////////////////OK
      if(messageTemp == "ok")
      {
        Serial.println("OK");
        irsend.sendRaw(ok, 73, 38);  // Send a raw data capture at 38kHz.
      }
      //source[815]////////////////////////////////////////////////////Exit
      if(messageTemp == "exit")
      {
        //Exit
        Serial.println("Exit");
        irsend.sendRaw(Exit, 73, 38);  // Send a raw data capture at 38kHz.
      }
      //Left
      if(messageTemp == "left")
      {
        Serial.println("left");
        irsend.sendRaw(left, 73, 38);  // Send a raw data capture at 38kHz.
      }
      //Right
      if(messageTemp == "right")
      {
        Serial.println("Right");
        irsend.sendRaw(right, 73, 38);  // Send a raw data capture at 38kHz.
      }

//Up
      if(messageTemp == "up")
      {
        Serial.println("Up");
        irsend.sendRaw(up, 73, 38);  // Send a raw data capture at 38kHz.
      }
      //Down
      if(messageTemp == "down")
      {
        Serial.println("Down");
        irsend.sendRaw(down, 73, 38);  // Send a raw data capture at 38kHz.
      }

       /////////////////////////////////////////////////Test TV
       if(messageTemp == "test1") 
      {
        digitalWrite(LED_PIN, HIGH);
      }

      if(messageTemp == "test0") 
      {
        digitalWrite(LED_PIN, LOW);
      }
   }
 }

//////////////////////////////////////////////////////////////////////////////////////////////////////////////////////////////////////////

void setup() {
  pinMode(LED_PIN, OUTPUT);

  for(int x = 0;x<2;x++)
  {
    digitalWrite(LED_PIN, HIGH);
    delay(1000);
    digitalWrite(LED_PIN, LOW);
  }
  
  delay(500);
  //Serial.begin(115200);
  irsend.begin();
  Serial.begin(115200, SERIAL_8N1, SERIAL_TX_ONLY);

  //connect to wifi if not connected already
  if (WiFi.status() != WL_CONNECTED)
    wifiConnect();
  //wifiConnect();
  client.setServer(mqtt_server, 1883);
  client.setCallback(callback);
}
void loop() {
  if (!client.connected()) 
  {
    reconnect();
  }
  if(!client.loop())
    client.connect("ESP_IR");

}
